//############################################################################################################################################################
//Externe Bibliotheken einbinden                                                                                                                             #
//############################################################################################################################################################

#include <avr/pgmspace.h>

//############################################################################################################################################################
//Programmspeicher beschreiben                                                                                                                               #
//############################################################################################################################################################

//Bild_01 (20:07-синий/озу)
const byte bild_01[] /*PROGMEM=*/
{
B00000000, B00000000, B00000000, B00000000, B00000000, B00000000, B00000000, B00000000, B00000000, B00000000, B00000000, B00000000, B00000000, B00000000, B00000000, 
B00000000, B00000000, B00000000, B00000000, B00000000, B00000000, B00000000, B00000000, B00000000, B00000000, B00000000, B00000000, B00010000, B01000000, B00000000, 
B00000000, B00000000, B00000000, B00000000, B00000000, B00000000, B00000000, B00000000, B00000000, B00000000, B00000000, B00000000, B00010000, B01000000, B00000000, 
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B00000000, B00000000, B00000000, B00000000, B00000000, B00000000, B00000000, B00000000, B00000000, B00000000, B00000000, B00000000, B00000000, B00000000, B00000000, 

};

//Bild_02 (20:07-красный/озу)
const byte bild_02[] /*PROGMEM=*/
{
B00000000, B00000000, B00000000, B00000000, B00000000, B00000000, B00000000, B00000000, B00000000, B00000000, B00000000, B00000000, B00000000, B00000000, B00000000, 
B00000000, B00000000, B00000000, B00000000, B00000000, B00000000, B00000000, B00010000, B01000000, B00000000, B00000000, B00000000, B00000000, B00000000, B00000000, 
B00000000, B00000000, B00000000, B00000000, B00000000, B00000000, B00000000, B00010000, B01000000, B00000000, B00000000, B00000000, B00000000, B00000000, B00000000, 
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B00000000, B00000000, B00000000, B00000000, B00000000, B00000000, B00000000, B00000000, B00000000, B00000000, B00000000, B00000000, B00000000, B00000000, B00000000, 

};

//Bild_03 (20:07-зеленый/pgm)
const byte bild_03[] PROGMEM=
{
B00000000, B00000000, B00000000, B00000000, B00000000, B00000000, B00000000, B00000000, B00000000, B00000000, B00000000, B00000000, B00000000, B00000000, B00000000, 
B00000000, B00000000, B00010000, B01000000, B00000000, B00000000, B00000000, B00000000, B00000000, B00000000, B00000000, B00000000, B00000000, B00000000, B00000000, 
B00000000, B00000000, B00010000, B01000000, B00000000, B00000000, B00000000, B00000000, B00000000, B00000000, B00000000, B00000000, B00000000, B00000000, B00000000, 
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B00000000, B00000000, B00000000, B00000000, B00000000, B00000000, B00000000, B00000000, B00000000, B00000000, B00000000, B00000000, B00000000, B00000000, B00000000, 

};



//############################################################################################################################################################
//Definitionen und Variablen                                                                                                                                 #
//############################################################################################################################################################

//Definition der Ausgangspins am µ-Controller
#define latchPin    53 // Latch-Pin//328==10//
#define PIN_SCK     52 // SPI Clock//328==13//
#define PIN_MISO    50 // SPI Dateneingang//328==12//
#define PIN_MOSI    51 // SPI Datenausgang//328==11//

#define debug_pin 8    // LED an Pin 8 zum Debuggen
#define LS_Pin    3    // Lichtschranke

#define N_O_S 200      // Anzahl Sektoren
#define v_offset 3     // Rotationsgeschwindigkeit des dargestellten Bildes
#define TOL 20         // Toleranz

unsigned long sector_time = 20;  // Sektorzeit in µs 
unsigned int     counter = 0;     // zählt später wieviele Sektoren wärend einer Umdrehung "geschaft" wurden
unsigned int     pointer = 0;     // zeigt später auf die richtige Stelle im Programmspeicher
unsigned int      offset = 0;     // Offset zum Pointer, der für die Drehung des Bildes sorgt
volatile byte         LS = 0;     // Austauschvariable zwischen Main-Prozedur und Interrupt-Service-Routine (LS = Licht-Schranke)
byte                mode = 1;     // Modus
unsigned long   end_time = 0;     // Endzeit eines Modus
byte            flag = 0;

//############################################################################################################################################################
//Setup - Prozedur                                                                                                                                           #
//############################################################################################################################################################

void setup()   
{               
  // Pins auf Ein- oder Ausgang stellen und einen Startwert zuweisen
  pinMode(latchPin,      OUTPUT);
  pinMode(PIN_SCK,       OUTPUT);       
  pinMode(PIN_MOSI,      OUTPUT);
  pinMode(debug_pin,     OUTPUT);
  pinMode(PIN_MISO,       INPUT);
  pinMode(LS_Pin,         INPUT);
  digitalWrite(latchPin,    LOW);
  digitalWrite(PIN_SCK,     LOW);
  digitalWrite(PIN_MOSI,    LOW);
  digitalWrite(debug_pin,   LOW);
  digitalWrite(PIN_MISO,   HIGH);  // Internen Pull-Up-Widerstand aktivieren
  digitalWrite(LS_Pin,     HIGH);  // Internen Pull-Up-Widerstand aktivieren
  
  //SPI Komunikation vorbereiten
  SPCR = B01010000; 
  
  //SPI Control Register (SPCR)
  
  // | 7    | 6    | 5    | 4    | 3    | 2    | 1    | 0    |
  // | SPIE | SPE  | DORD | MSTR | CPOL | CPHA | SPR1 | SPR0 |

  // SPIE - Enables the SPI interrupt when 1
  // SPE  - Enables the SPI when 1
  // DORD - Sends data least Significant Bit First when 1, most Significant Bit first when 0
  // MSTR - Sets the Arduino in master mode when 1, slave mode when 0
  // CPOL - Sets the data clock to be idle when high if set to 1, idle when low if set to 0
  // CPHA - Samples data on the falling edge of the data clock when 1, rising edge when 0
  //SPR1 and SPR0 - Sets the SPI speed, 00 is fastest (4MHz) 11 is slowest (250KHz)
  
  SPSR = B00000000; //SPI Status Register auf 0 setzen
    
  //Alle LEDs aus
  all_leds_off();
  
  digitalWrite(debug_pin, HIGH);
  
  // Warten bis Motor Nenndrehzahl erreicht hat  
  for (byte a=0; a<50; a++)
  {
    while (digitalRead(LS_Pin) == HIGH) {delayMicroseconds(1);}
    delay(20);
  }
  
  digitalWrite(debug_pin, LOW);
  
  end_time = millis() + (random(10,20) * 1000);
  mode = 1;

  //Interrupt vorbereiten
  attachInterrupt(1, Erkenne_Flanke, FALLING);
}

//############################################################################################################################################################
//Hauptprogramm                                                                                                                                              #
//############################################################################################################################################################

void loop()                     
{    
    LS = 0;
    
    if (flag == 0)
    {
      if (counter < (N_O_S)) {sector_time--;}
      if (counter > (N_O_S)) {sector_time++;}
    }
    
    if (counter == N_O_S) {flag = 1;}
    if ((counter < (N_O_S - TOL)) || (counter > (N_O_S + TOL))) {flag = 0;}
  
    if (end_time < millis())
    {
      end_time = millis() + (random(10,20) * 1000);
      flag=0;
      mode++;
      if (mode == 4) {mode = 1;}
    }
  
    counter = 0;
    if (offset > (N_O_S - 1)) {offset = 0;}
    
    EnableSPI();
 
    while (LS == 0) 
    {
        if (counter < N_O_S) {pointer = counter;} else {pointer = N_O_S - 1;}      
        pointer = pointer + offset;
        if (pointer > (N_O_S - 1)) {pointer = pointer - N_O_S;}
      
        pointer = pointer * 15;
    
        digitalWrite(latchPin, LOW);                                                          // LatchPin erden, damit LEDs nicht schon beim "Durchschieben" blinken
       
        switch (mode)
        {
        case 1: for (int l=0; l<15; l++){SendRecSPI((bild_01[pointer + l]));}      // 15 Byte für SR#15 bis SR#1 rausschieben
                break;
        case 2: for (int l=0; l<15; l++){SendRecSPI((bild_02[pointer + 1]));}      // 15 Byte für SR#15 bis SR#1 rausschieben
                break;
        case 3: for (int l=0; l<15; l++){SendRecSPI(pgm_read_byte_near(bild_03 + pointer + l));}      // 15 Byte für SR#15 bis SR#1 rausschieben
                break;           
        }
        
        digitalWrite(latchPin, HIGH);                                                         // LatchPin auf HIGH setzen und damit alle SR aktivieren
        
        counter++;
                                                           
        unsigned long end_micros = micros() + sector_time;                                    
        while ((micros() < end_micros) && (LS == 0)) {}                                       // Warten bis Sektorzeit vorüber ist
                      
                     
                                       
    }  
    
    DisableSPI();
    
    offset = offset + v_offset;
}

//############################################################################################################################################################
//Interrupt-Service-Routine                                                                                                                                  #
//############################################################################################################################################################

void Erkenne_Flanke(void)
{
  LS = 1;
}

//############################################################################################################################################################
//Hilfsfunktion zum Aussschalten aller LEDs                                                                                                                  #
//############################################################################################################################################################

void all_leds_off(void)
{
  EnableSPI();
  digitalWrite(latchPin, LOW);                         // LatchPin erden, damit LEDs nicht schon beim "Durchschieben" blinken
  for (int l=0; l<15; l++){SendRecSPI(0);}             // 15 Byte für SR#15 bis SR#1 rausschieben
  digitalWrite(latchPin, HIGH);                        // LatchPin auf HIGH setzen und damit alle SR aktivieren
  DisableSPI();
}

//############################################################################################################################################################
// Prozeduren für die SPI                                                                                                                                    #
//############################################################################################################################################################

void EnableSPI(void)  {SPCR |= 1 << SPE;}
void DisableSPI(void) {SPCR &= ~(1 << SPE);}
void WaitSPIF(void) {while (! (SPSR & (1 << SPIF))) {continue;}}
  
void SendRecSPI(byte Dbyte) 
{        
  SPDR = Dbyte;
  WaitSPIF();
  //return SPDR;    //Schiebregister schicken nichts zurück
}

//############################################################################################################################################################
//############################################################################################################################################################
//############################################################################################################################################################
